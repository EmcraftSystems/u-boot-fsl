## arch/arm/mach-imx/imx8m/Kconfig
```kconfig
if ARCH_IMX8M

config IMX8M
	bool
	select HAS_CAAM
	select ROM_UNIFIED_SECTIONS

config IMX8MQ
	bool
	select IMX8M

config IMX8MM
	bool
	select IMX8M

choice
	prompt	"NXP i.MX8M board select"
	optional

config TARGET_IMX8MQ_EVK
	bool "imx8mq_evk"
	select IMX8MQ
	select SUPPORT_SPL
	select IMX8M_LPDDR4

config TARGET_IMX8MQ_DDR3L_ARM2
	bool "imx8mq_ddr3l_arm2"
	select IMX8MQ
	select SUPPORT_SPL

config TARGET_IMX8MQ_DDR4_ARM2
	bool "imx8mq_ddr4_arm2"
	select IMX8MQ
	select SUPPORT_SPL

config TARGET_IMX8MQ_PHANBELL
	bool "imx8mq_phanbell"
	select IMX8MQ
	select SUPPORT_SPL

config TARGET_IMX8MM_DDR4_VAL
	bool "imx8mm DDR4 validation board"
	select IMX8MM
	select SUPPORT_SPL

config TARGET_IMX8MM_DDR3L_VAL
	bool "imx8mm DDR3L validation board"
	select IMX8MM
	select SUPPORT_SPL

config TARGET_IMX8MM_EVK
	bool "imx8mm LPDDR4 EVK board"
	select IMX8MM
	select SUPPORT_SPL
	select IMX8M_LPDDR4

config TARGET_IMX8MM_DDR4_EVK
	bool "imx8mm DDR4 EVK board"
	select IMX8MM
	select SUPPORT_SPL
	select IMX8M_DDR4

endchoice

choice
	prompt  "EmCraft i.MX8M board select"
	optional

config TARGET_EMCRAFT_IMX8M_LPDDR4_SOM
	bool "emcraft_imx8m_lpddr4_som"
	select IMX8MQ
	select SUPPORT_SPL

config TARGET_EMCRAFT_IMX8M_LPDDR4_2GB_SOM
	bool "emcraft_imx8m_lpddr4_2gb_som"
	select IMX8MQ
	select SUPPORT_SPL

config TARGET_EMCRAFT_IMX8M_LPDDR4_3GB_SOM
	bool "emcraft_imx8m_lpddr4_3gb_som"
	select IMX8MQ
	select SUPPORT_SPL

config TARGET_EMCRAFT_IMX8M_LPDDR4_4GB_SOM
	bool "emcraft_imx8m_lpddr4_4gb_som"
	select IMX8MQ
	select SUPPORT_SPL

config TARGET_EMCRAFT_IMX8MM_SOM
	bool "i.MX8M Mini 2GB SOM"
	select IMX8MM
	select SUPPORT_SPL
	select IMX8M_LPDDR4

config TARGET_EMCRAFT_IMX8MM_SOM_1GB
	bool "i.MX8M Mini 1GB SOM"
	select IMX8MM
	select SUPPORT_SPL
	select IMX8M_LPDDR4

config TARGET_EMCRAFT_IMX8MM_SOM_3GB
	bool "i.MX8M Mini 3GB SOM"
	select IMX8MM
	select SUPPORT_SPL
	select IMX8M_LPDDR4

endchoice

config SYS_SOC
	default "imx8m"

source "board/freescale/imx8mq_evk/Kconfig"
source "board/freescale/imx8mq_arm2/Kconfig"
source "board/freescale/imx8mq_phanbell/Kconfig"
source "board/freescale/imx8mm_evk/Kconfig"
source "board/freescale/imx8mm_val/Kconfig"
source "board/emcraft/imx8mm_som/Kconfig"
source "board/emcraft/imx8m_som/Kconfig"

endif
```

## arch/arm/mach-imxrt105x/Kconfig
```kconfig
if ARCH_IMXRT105X

config SYS_SOC
	default "imxrt105x"

choice
	prompt "MXRT105X board select"
	optional

config TARGET_MXRT105X_EVK
        bool "Support mxrt105x EVK board"

config TARGET_MXRT106X_EVK
        bool "Support mxrt106x EVK board"

endchoice

source "board/freescale/mxrt105x-evk/Kconfig"
source "board/freescale/mxrt106x-evk/Kconfig"

endif
```

## board/emcraft/imx8m_som/Kconfig
```kconfig
if TARGET_EMCRAFT_IMX8M_LPDDR4_SOM || TARGET_EMCRAFT_IMX8M_LPDDR4_2GB_SOM || \
   TARGET_EMCRAFT_IMX8M_LPDDR4_3GB_SOM || TARGET_EMCRAFT_IMX8M_LPDDR4_4GB_SOM

config SYS_BOARD
	default "imx8m_som"

config SYS_VENDOR
	default "emcraft"

config SYS_CONFIG_NAME
	default "imx8m_som"

source "board/freescale/common/Kconfig"

endif
```

## board/emcraft/imx8m_som/ddr/Kconfig
```kconfig
if SPL_DDR_SUPPORT

choice
	prompt "ddr phy fw select"
	default DDR3_FW_100

config LPDDR4_FW_100
	bool "lpddr4 phy fw100"

config DDR3_FW_100
	bool "ddr3 phy fw100"

endchoice

choice
	prompt "ddr initial select"
	default DDR3_1600MTS_ONE_FW_100

config LPDDR4_3200MTS_TWO_FW_100
	bool "lpddr4 3200mts two rank fw100"
	depends on LPDDR4_FW_100

config DDR3_1600MTS_ONE_FW_100
	bool "ddr3 1600mts one rank fw100"
	depends on DDR3_FW_100
endchoice

endif
```

## board/emcraft/imx8mm_som/Kconfig
```kconfig
if TARGET_EMCRAFT_IMX8MM_SOM || TARGET_EMCRAFT_IMX8MM_SOM_1GB || TARGET_EMCRAFT_IMX8MM_SOM_3GB

config SYS_BOARD
	default "imx8mm_som"

config SYS_VENDOR
	default "emcraft"

config SYS_CONFIG_NAME
	default "imx8mm_som"

source "board/freescale/common/Kconfig"

endif
```

## board/emcraft/slx-som/Kconfig
```kconfig
if TARGET_SLX_SOM

config SYS_BOARD
	default "slx-som"

config SYS_VENDOR
	default "emcraft"

config SYS_SOC
	default "mx6"

config SYS_CONFIG_NAME
	default "slx-som"

endif
```

## board/freescale/mxrt105x-evk/Kconfig
```kconfig
if TARGET_MXRT105X_EVK

config SYS_BOARD
	string
	default "mxrt105x-evk"

config SYS_VENDOR
	string
	default "freescale"

config SYS_SOC
	string
	default "imxrt105x"

config SYS_CONFIG_NAME
	string
	default "mxrt105x-evk"

endif
```

## board/freescale/mxrt106x-evk/Kconfig
```kconfig
if TARGET_MXRT106X_EVK

config SYS_BOARD
	string
	default "mxrt106x-evk"

config SYS_VENDOR
	string
	default "freescale"

config SYS_SOC
	string
	default "imxrt105x"

config SYS_CONFIG_NAME
	string
	default "mxrt106x-evk"

endif
```

## board/freescale/mxrt117x-evk/Kconfig
```kconfig
if TARGET_MXRT117X_EVK

config SYS_BOARD
	string
	default "mxrt117x-evk"

config SYS_VENDOR
	string
	default "freescale"

config SYS_SOC
	string
	default "imxrt105x"

config SYS_CONFIG_NAME
	string
	default "mxrt117x-evk"

endif
```

## configs/imx8m_lpddr4_2gb_som_defconfig
```kconfig
CONFIG_ARM=y
CONFIG_ARCH_IMX8M=y
CONFIG_SYS_MALLOC_F_LEN=0x2000
CONFIG_TARGET_EMCRAFT_IMX8M_LPDDR4_2GB_SOM=y
CONFIG_SYS_EXTRA_OPTIONS="IMX_CONFIG=arch/arm/imx-common/spl_sd.cfg"
CONFIG_DEFAULT_FDT_FILE="emcraft-imx8m-som.dtb"
CONFIG_SPL=y
CONFIG_HUSH_PARSER=y
CONFIG_OF_LIBFDT=y
CONFIG_CMD_CACHE=y
CONFIG_DEFAULT_DEVICE_TREE="emcraft-imx8m-som"
CONFIG_OF_CONTROL=y
CONFIG_PINCTRL=y
CONFIG_PINCTRL_IMX8M=y
CONFIG_SYS_I2C_MXC=y
CONFIG_CMD_I2C=y
CONFIG_DM_I2C=y
CONFIG_DM_GPIO=y
CONFIG_CMD_GPIO=y
CONFIG_DM_MMC=y
# CONFIG_DM_MMC_OPS is not set
# CONFIG_BLK is not set
CONFIG_CMD_MEMTEST=y
CONFIG_CMD_REGULATOR=y
CONFIG_DM_PMIC=y
CONFIG_POWER_BD71837=y
CONFIG_POWER_BD71837_I2C_BUS=0
CONFIG_POWER_BD71837_I2C_ADDR=0x4B
CONFIG_DM_REGULATOR=y
CONFIG_DM_REGULATOR_FIXED=y
CONFIG_DM_REGULATOR_GPIO=y
CONFIG_DM_ETH=y
CONFIG_CMD_PMIC=y
CONFIG_NXP_TMU=y
CONFIG_DM_THERMAL=y
CONFIG_FIT=y
CONFIG_SPL_FIT=y
CONFIG_SPL_LOAD_FIT=y
```

## configs/mxrt117x-evk_defconfig
```kconfig
CONFIG_ARM=y
# CONFIG_SPL_SYS_THUMB_BUILD is not set
CONFIG_ARCH_IMXRT105X=y
CONFIG_TARGET_MXRT117X_EVK=y
CONFIG_DEFAULT_DEVICE_TREE="imxrt117x-evk"
# CONFIG_SYS_MALLOC_F is not set
CONFIG_FIT=y
CONFIG_SYS_EXTRA_OPTIONS="IMX_CONFIG=board/freescale/mxrt117x-evk/imximage.cfg"
# CONFIG_ARCH_FIXUP_FDT_MEMORY is not set
CONFIG_SPI_BOOT=y
CONFIG_ENV_IS_IN_SPI_FLASH=y
CONFIG_BOOTDELAY=0
CONFIG_DEFAULT_FDT_FILE="imxrt117x-evk"
CONFIG_HUSH_PARSER=y
CONFIG_CMD_MEMTEST=y
CONFIG_CMD_MMC=y
CONFIG_CMD_SF=y
CONFIG_DOS_PARTITION=y
CONFIG_OF_CONTROL=y
CONFIG_OF_FORCE_RELOCATE=y
CONFIG_DM=y
# CONFIG_BLK is not set
CONFIG_DM_MMC=y
# CONFIG_DM_MMC_OPS is not set
CONFIG_SPI_FLASH=y
CONFIG_SPI_FLASH_ISSI=y
# CONFIG_SPI_FLASH_USE_4K_SECTORS is not set
CONFIG_PHYLIB=y
CONFIG_PHY_MICREL=y
CONFIG_DM_ETH=y
CONFIG_FEC_MXC=y
# CONFIG_SPL_SERIAL_PRESENT is not set
CONFIG_DM_SERIAL=y
CONFIG_FSL_LPUART=y
CONFIG_FSL_FLEXSPI=y
CONFIG_FS_FAT=y
CONFIG_FAT_WRITE=y
# CONFIG_EFI_LOADER is not set
```

## configs/slx-som_defconfig
```kconfig
CONFIG_SYS_EXTRA_OPTIONS="IMX_CONFIG=board/emcraft/slx-som/imximage.cfg,MX6SX"
CONFIG_ARM=y
CONFIG_TARGET_SLX_SOM=y
CONFIG_DM=y
CONFIG_DM_THERMAL=y
```
